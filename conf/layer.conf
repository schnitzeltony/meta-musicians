## conf/layer.conf
```bitbake
# We have a conf and classes directory, append to BBPATH
BBPATH .= ":${LAYERDIR}"

# recipes
BBFILES += "${LAYERDIR}/recipes-*/*.bb ${LAYERDIR}/recipes-*/*/*.bb ${LAYERDIR}/recipes-*/*/*/*.bb"
# appends
BBFILES += "${LAYERDIR}/appends/*/*.bbappend"


BBFILE_COLLECTIONS += "meta-musicians"
BBFILE_PATTERN_meta-musicians := "^${LAYERDIR}/"
BBFILE_PRIORITY_meta-musicians = "20"

# ffmpeg4-layer: https://github.com/schnitzeltony/meta-ffmpeg4
LAYERDEPENDS_meta-musicians = " \
    core \
    openembedded-layer \
    multimedia-layer \
    ffmpeg4-layer \
    networking-layer \
    xfce-layer \
    gnome-layer \
    meta-python \
    qt5-layer \
"
LAYERSERIES_COMPAT_meta-musicians = "honister kirkstone langdale"
```
